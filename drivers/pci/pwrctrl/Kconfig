## drivers/pci/pwrctrl/Kconfig
```kconfig
# SPDX-License-Identifier: GPL-2.0-only

config HAVE_PWRCTL
	bool

config PCI_PWRCTL
	tristate

config PCI_PWRCTL_PWRSEQ
	tristate
	select POWER_SEQUENCING
	select PCI_PWRCTL

config PCI_PWRCTRL_QPS615
	tristate "PCI Power Control driver for QPS615"
	select PCI_PWRCTRL
	help
	  Say Y here to enable the pwrctrl driver for Qualcomm
	  QPS615 PCIe switch which enables and configures it
	  through i2c.
```
